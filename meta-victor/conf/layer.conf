## meta-victor/conf/layer.conf
```bitbake
# We have a conf and classes directory, add to BBPATH
BBPATH .= ":${LAYERDIR}"

# We have recipes-* directories, add to BBFILES
BBFILES += "${LAYERDIR}/recipes-*/*/*.bb \
            ${LAYERDIR}/recipes-*/*/*.bbappend"

BBFILE_COLLECTIONS += "meta-victor"
BBFILE_PATTERN_meta-victor = "^${LAYERDIR}/"
BBFILE_PRIORITY_meta-victor = "6"

LAYERDEPENDS_meta-victor = "core"
LAYERSERIES_COMPAT_meta-victor = "honister"
IMAGE_INSTALL_append = "projeto0.1"
```
